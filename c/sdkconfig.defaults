## c/sdkconfig.defaults
```kconfig
CONFIG_IDF_TARGET="esp32s3"
CONFIG_BT_ENABLED=y
CONFIG_BT_NIMBLE_ENABLED=y
CONFIG_BT_NIMBLE_ROLE_PERIPHERAL=y
CONFIG_USB_HOST_ENABLED=y
CONFIG_ESP_HID_HOST_ENABLED=y
CONFIG_ESP_HID_HOST_USB_ENABLED=y
CONFIG_ESP_HID_HOST_BLE_ENABLED=n
CONFIG_ESP_HID_HOST_BT_ENABLED=n
```
